/*
 * LCD.cpp - Nokia 5110 LCD Display Driver Implementation
 * Hardware Abstraction Layer for PCD8544 Controller
 */

#include "LCD.h"
#include <string.h>

// 5x7 Font data (ASCII 32-126)
// Each character is 5 bytes (columns), each byte represents 8 vertical pixels
static const uint8_t font5x7[][5] = {
    {0x00, 0x00, 0x00, 0x00, 0x00}, // space (32)
    {0x00, 0x00, 0x5F, 0x00, 0x00}, // !
    {0x00, 0x07, 0x00, 0x07, 0x00}, // "
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    {0x78, 0x46, 0x41, 0x46, 0x78}  // DEL
};

LCD::LCD(uint8_t rst, uint8_t ce, uint8_t dc, uint8_t din, uint8_t clk) {
    _rst = rst;
    _ce = ce;
    _dc = dc;
    _din = din;
    _clk = clk;
    _cursorX = 0;
    _cursorY = 0;
    _contrast = 0x3F;
    _inverse = false;
    
    // Clear display buffer
    memset(_displayBuffer, 0, sizeof(_displayBuffer));
}

void LCD::begin(void) {
    // Configure pins
    pinMode(_rst, OUTPUT);
    pinMode(_ce, OUTPUT);
    pinMode(_dc, OUTPUT);
    pinMode(_din, OUTPUT);
    pinMode(_clk, OUTPUT);
    
    // Set initial pin states
    digitalWrite(_ce, HIGH);
    digitalWrite(_rst, HIGH);
    digitalWrite(_dc, LOW);
    
    // Initialize SPI for ESP32
    SPI.begin(_clk, -1, _din, _ce);
    SPI.beginTransaction(SPISettings(4000000, MSBFIRST, SPI_MODE0));
    
    // Reset display
    digitalWrite(_rst, LOW);
    delay(10);
    digitalWrite(_rst, HIGH);
    delay(10);
    
    // Initialize display
    initDisplay();
}

void LCD::initDisplay(void) {
    // Function set: extended instruction set
    writeCommand(LCD_CMD_MODE | 0x01);
    
    // Set VOP (contrast)
    writeCommand(LCD_CMD_VOP | _contrast);
    
    // Set temperature coefficient
    writeCommand(LCD_CMD_TEMP | 0x02);
    
    // Set bias system
    writeCommand(LCD_CMD_BIAS | 0x03);
    
    // Function set: basic instruction set
    writeCommand(LCD_CMD_MODE);
    
    // Set display control
    writeCommand(LCD_CMD_DISPLAY | LCD_DISPLAY_NORMAL);
    
    // Clear display
    clear();
}

void LCD::writeCommand(uint8_t cmd) {
    digitalWrite(_dc, LOW);  // Command mode
    digitalWrite(_ce, LOW);
    SPI.transfer(cmd);
    digitalWrite(_ce, HIGH);
    delayMicroseconds(1);
}

void LCD::writeData(uint8_t data) {
    digitalWrite(_dc, HIGH); // Data mode
    digitalWrite(_ce, LOW);
    SPI.transfer(data);
    digitalWrite(_ce, HIGH);
    delayMicroseconds(1);
}

void LCD::setAddress(uint8_t x, uint8_t y) {
    writeCommand(LCD_CMD_X_ADDR | x);
    writeCommand(LCD_CMD_Y_ADDR | y);
}

void LCD::clear(void) {
    setAddress(0, 0);
    for (uint16_t i = 0; i < (LCD_WIDTH * LCD_HEIGHT / 8); i++) {
        writeData(0x00);
        _displayBuffer[i] = 0x00;
    }
    setAddress(0, 0);
    _cursorX = 0;
    _cursorY = 0;
}

void LCD::setContrast(uint8_t contrast) {
    _contrast = contrast & 0x7F;
    writeCommand(LCD_CMD_MODE | 0x01);  // Extended instruction set
    writeCommand(LCD_CMD_VOP | _contrast);
    writeCommand(LCD_CMD_MODE);          // Basic instruction set
}

void LCD::setCursor(uint8_t x, uint8_t y) {
    if (x >= LCD_WIDTH) x = LCD_WIDTH - 1;
    if (y >= LCD_HEIGHT / 8) y = (LCD_HEIGHT / 8) - 1;
    _cursorX = x;
    _cursorY = y;
    setAddress(x, y);
}

void LCD::drawPixel(uint8_t x, uint8_t y, uint8_t color) {
    if (x >= LCD_WIDTH || y >= LCD_HEIGHT) return;
    
    uint16_t index = x + (y / 8) * LCD_WIDTH;
    uint8_t bit = y % 8;
    
    if (color) {
        _displayBuffer[index] |= (1 << bit);
    } else {
        _displayBuffer[index] &= ~(1 << bit);
    }
}

void LCD::updateDisplay(void) {
    setAddress(0, 0);
    for (uint16_t i = 0; i < (LCD_WIDTH * LCD_HEIGHT / 8); i++) {
        writeData(_displayBuffer[i]);
    }
}

void LCD::printChar(char c) {
    // Handle special characters
    if (c == '\n') {
        _cursorY++;
        _cursorX = 0;
        if (_cursorY >= (LCD_HEIGHT / 8)) {
            _cursorY = 0;
        }
        setAddress(_cursorX, _cursorY);
        return;
    }
    
    if (c == '\r') {
        _cursorX = 0;
        setAddress(_cursorX, _cursorY);
        return;
    }
    
    // Only print printable ASCII characters (32-126)
    if (c < 32 || c > 126) {
        c = '?'; // Replace invalid characters with '?'
    }
    
    // Get font data for the character
    const uint8_t* fontData = font5x7[c - 32];
    uint8_t baseY = _cursorY * 8;
    
    // Draw the character (5 columns)
    for (uint8_t col = 0; col < 5; col++) {
        if (_cursorX + col < LCD_WIDTH) {
            uint8_t fontByte = fontData[col];
            // Draw each pixel in the column (7 pixels high)
            // Bit 0 is top pixel, bit 6 is bottom pixel
            for (uint8_t row = 0; row < 7; row++) {
                if (baseY + row < LCD_HEIGHT) {
                    uint8_t pixel = (fontByte >> row) & 0x01;
                    drawPixel(_cursorX + col, baseY + row, pixel);
                }
            }
        }
    }
    
    // Move cursor (5 pixels for character + 1 pixel spacing)
    _cursorX += 6;
    if (_cursorX >= LCD_WIDTH) {
        _cursorX = 0;
        _cursorY++;
        if (_cursorY >= (LCD_HEIGHT / 8)) {
            _cursorY = 0;
        }
    }
    setAddress(_cursorX, _cursorY);
}

void LCD::print(const char* str) {
    while (*str) {
        printChar(*str++);
    }
    updateDisplay();
}

void LCD::setInverse(bool inverse) {
    _inverse = inverse;
    uint8_t displayMode = _inverse ? LCD_DISPLAY_INVERT : LCD_DISPLAY_NORMAL;
    writeCommand(LCD_CMD_DISPLAY | displayMode);
}

void LCD::setPower(bool on) {
    uint8_t displayMode = on ? LCD_DISPLAY_NORMAL : LCD_DISPLAY_BLANK;
    writeCommand(LCD_CMD_DISPLAY | displayMode);
}

